/*
 * Script Base
 * 2024 V1.0
 * Environmental Data Acquisition System
 * Vargas Edwin - Camargo Ruben - Quirama Miguel - Salazar Camilo - Martinez Darwin - Sanchez Joaquin
 */

/*
 * 1. Librerias requeridas
 */
#include <SPI.h>
#include <Wire.h>
#include <SoftwareSerial.h>
#include <Adafruit_SSD1306.h>
#include <Fonts/FreeSerif12pt7b.h>
#include <Fonts/FreeSansBold12pt7b.h>
#include <Fonts/FreeMonoOblique12pt7b.h>
#include <Fonts/FreeMonoBold12pt7b.h>
#include <Fonts/FreeSansOblique12pt7b.h>
#include <TinyGPS++.h>
#include <DHT.h>
#include "RtcDS3231.h"
#include "FS.h"
#include "SD.h"
#include <math.h>
#include "painlessMesh.h"
#include <Adafruit_Sensor.h>
#include "Fonts/FreeSans12pt7b.h"
#include <Arduino.h>
#include "Sensirion_GadgetBle_Lib.h"
#include "Adafruit_PM25AQI.h"
#include "SPI.h"
#include <WiFi.h>
#include <Firebase_ESP_Client.h>
#include <addons/TokenHelper.h>
#include <Fonts/FreeSerifBoldItalic9pt7b.h>
#include "BluetoothSerial.h"
#include <RTClib.h>
//------------------------------------------------------------------------------------------------------------------------

/*
 * 2. Iconos usados en la iterfaz respectiva para OLED display
 */
const unsigned char logo_ste [] PROGMEM = {
	0x08, 0x00, 0x00, 0x00, 0x1c, 0x00, 0x00, 0x00, 0x3e, 0x00, 0x00, 0x00, 0x7e, 0x00, 0x00, 0x00, 
	0xff, 0x00, 0x00, 0x00, 0x7f, 0x80, 0x00, 0x00, 0x3f, 0xc0, 0x00, 0x00, 0x0f, 0xf0, 0x00, 0x00, 
	0x07, 0xf8, 0x00, 0x00, 0x03, 0xfc, 0x60, 0x00, 0x01, 0xfc, 0xf0, 0x00, 0x01, 0xf9, 0xf8, 0x00, 
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	0x00, 0x00, 0x00, 0xe0, 0x00, 0x00, 0x00, 0x40
};
const unsigned char blue[] PROGMEM={
	0x00, 0x00, 0x00, 0x00, 0x00, 0x00, 0x00, 0x00, 0x00, 0x00, 0x00, 0x00, 0x00, 0x00, 0x00, 0x00, 
	0x00, 0x00, 0x00, 0x00, 0x00, 0x00, 0x00, 0x00, 0x00, 0x00, 0x00, 0x00, 0x00, 0x00, 0x00, 0xc0, 
	0x00, 0x00, 0x00, 0x00, 0x00, 0x00, 0xe0, 0x00, 0x00, 0x00, 0x00, 0x00, 0x00, 0xf0, 0x00, 0x00, 
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	0x00, 0x00, 0x00, 0x00, 0x00, 0x00, 0x00, 0x00, 0x00, 0x00, 0x00, 0x00
};
const unsigned char Sensirion [750] PROGMEM = {
	0xff, 0xff, 0xff, 0xff, 0xff, 0xff, 0xff, 0xff, 0xff, 0xff, 0xff, 0xff, 0xff, 0xff, 0xe0, 0xff, 
	0xff, 0xff, 0xff, 0xff, 0x3f, 0xff, 0xff, 0xff, 0xff, 0xff, 0xe1, 0xff, 0xff, 0xe0, 0xe0, 0x07, 
	0xe0, 0x18, 0x7e, 0x3c, 0x00, 0x71, 0xc0, 0x0f, 0x8f, 0xc0, 0x7c, 0x3f, 0x00, 0xc0, 0x07, 0xc0, 
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	0xff, 0xff, 0xff, 0xff, 0xff, 0xff, 0xff, 0xff, 0xff, 0xff, 0xff, 0xff, 0xff, 0xe0
};
const unsigned char fire [750] PROGMEM = {
	0xff, 0xff, 0xff, 0xff, 0xff, 0xff, 0xff, 0xff, 0xff, 0xff, 0xff, 0xff, 0xff, 0xff, 0xe0, 0xff, 
	0xff, 0xff, 0xff, 0xff, 0xff, 0xff, 0xff, 0xff, 0xff, 0xff, 0xff, 0xff, 0xff, 0xe0, 0xff, 0xff, 
	0xff, 0xff, 0xff, 0xff, 0xff, 0xff, 0xff, 0xff, 0xff, 0xff, 0xff, 0xff, 0xe0, 0xff, 0xff, 0xff, 
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	0xff, 0xff, 0xff, 0xff, 0xff, 0xff, 0xff, 0xff, 0xff, 0xff, 0xff, 0xff, 0xff, 0xe0
};
const unsigned char UniversidadSergioArboleda[] PROGMEM = {
  0xff, 0xff, 0xff, 0xff, 0xff, 0xff, 0xff, 0xff, 0xff, 0xff, 0xff, 0xff, 0xff, 0xff, 0xff, 0xff,
  0xff, 0xff, 0xff, 0xff, 0xff, 0xff, 0xff, 0xff, 0xff, 0xff, 0xff, 0xff, 0xff, 0xff, 0xff, 0xff,
  0xe0, 0x00, 0x00, 0xff, 0xff, 0xff, 0xff, 0xff, 0xff, 0xff, 0xff, 0xff, 0xff, 0xff, 0xff, 0xff,
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  0xff, 0xff, 0xff, 0xff, 0xff, 0xff, 0xff, 0xff, 0xff, 0xff, 0xff, 0xff, 0xff, 0xff, 0xff, 0xff
};
const unsigned char logo[] PROGMEM = {
  0xff, 0x9f, 0xf0, 0xff, 0x9f, 0xf0, 0xee, 0x07, 0x70, 0xc0, 0x00, 0x30, 0xe0, 0xf0, 0x70, 0xe3,
  0xfc, 0x70, 0xe7, 0xce, 0x70, 0xc7, 0xe7, 0x30, 0xcf, 0xe3, 0x30, 0x0d, 0xe3, 0x00, 0x0c, 0xe3,
  0x00, 0x8c, 0x03, 0xb0, 0xc6, 0x01, 0xf0, 0xe7, 0x00, 0xf0, 0xe3, 0xf0, 0x70, 0xe1, 0xf8, 0x30,
  0xc0, 0x0c, 0x10, 0xee, 0x0e, 0x00, 0xff, 0x0f, 0x00, 0xff, 0x9f, 0x90

};
const unsigned char icon_hot[] PROGMEM = {
  0xff, 0xef, 0xf0, 0xff, 0xc7, 0xf0, 0xff, 0x87, 0xf0, 0xff, 0x87, 0xf0, 0xff, 0x03, 0xf0, 0xff,
  0x01, 0xf0, 0xff, 0x00, 0xf0, 0xf3, 0x00, 0xf0, 0xe3, 0x00, 0x70, 0xe0, 0x00, 0x70, 0xe0, 0x00,
  0x70, 0xe0, 0x00, 0x70, 0xe0, 0x00, 0x70, 0xe0, 0x20, 0x70, 0xe0, 0x30, 0x70, 0xe0, 0x70, 0x70,
  0xf0, 0xf0, 0xf0, 0xf0, 0xf0, 0xf0, 0xfc, 0xf1, 0xf0, 0xfe, 0x07, 0xf0
};
const unsigned char location[] PROGMEM = {
  0xff, 0x0f, 0xf0, 0xfc, 0x03, 0xf0, 0xf8, 0x01, 0xf0, 0xf0, 0x00, 0xf0, 0xf0, 0xf0, 0xf0, 0xf1,
  0xf8, 0xf0, 0xf1, 0xf8, 0xf0, 0xf1, 0xf8, 0xf0, 0xf0, 0xf0, 0xf0, 0xf0, 0x00, 0xf0, 0xf8, 0x01,
  0xf0, 0xfc, 0x03, 0xf0, 0xfc, 0x03, 0xf0, 0xfe, 0x07, 0xf0, 0xe3, 0x0c, 0x70, 0xc1, 0x08, 0x30,
  0x81, 0x98, 0x10, 0xc0, 0x90, 0x30, 0xe0, 0x60, 0x70, 0xf8, 0x01, 0xf0
};
const unsigned char icon_humedity[] PROGMEM = {
  0xff, 0x9f, 0xf0, 0xff, 0x9f, 0xf0, 0xff, 0x2f, 0xf0, 0xfe, 0x67, 0xf0, 0xfc, 0xf3, 0xf0, 0xfd,
  0xfb, 0xf0, 0xfb, 0xfd, 0xf0, 0xf3, 0xfc, 0xf0, 0xf4, 0x3e, 0xf0, 0xe4, 0xb3, 0x70, 0xee, 0x27,
  0x70, 0xef, 0xcf, 0x70, 0xef, 0x9f, 0x70, 0xef, 0x3f, 0x70, 0xee, 0x47, 0x70, 0xec, 0xd3, 0x70,
  0xf7, 0xc2, 0xf0, 0xf3, 0xfc, 0xf0, 0xfc, 0xf1, 0xf0, 0xfe, 0x07, 0xf0
};
const unsigned char temperature[] PROGMEM = {
  0xfe, 0x3f, 0xf0, 0xfc, 0xdf, 0xf0, 0xfd, 0xe8, 0xf0, 0xfd, 0xe9, 0xf0, 0xfd, 0xef, 0xf0, 0xfd,
  0x68, 0xf0, 0xfd, 0x6f, 0xf0, 0xfd, 0x68, 0xf0, 0xfd, 0x6f, 0xf0, 0xfd, 0x68, 0xf0, 0xfd, 0x69,
  0xf0, 0xfd, 0x6f, 0xf0, 0xf9, 0x67, 0xf0, 0xf2, 0x37, 0xf0, 0xf6, 0xd3, 0xf0, 0xf4, 0xd3, 0xf0,
  0xf2, 0x17, 0xf0, 0xfb, 0x37, 0xf0, 0xf9, 0xcf, 0xf0, 0xfe, 0x1f, 0xf0
};
const unsigned char clockl[] PROGMEM = {
  0xfe, 0x07, 0xf0, 0xf8, 0x01, 0xf0, 0xe0, 0x00, 0x70, 0xc0, 0x60, 0x30, 0xc0, 0x60, 0x30, 0x80,
  0x60, 0x10, 0x80, 0x60, 0x10, 0x00, 0x60, 0x00, 0x00, 0x60, 0x00, 0x00, 0x60, 0x00, 0x00, 0x60,
  0x00, 0x00, 0x18, 0x00, 0x00, 0x1c, 0x00, 0x80, 0x0c, 0x10, 0x80, 0x00, 0x10, 0xc0, 0x00, 0x30,
  0xc0, 0x00, 0x30, 0xe0, 0x00, 0x70, 0xf8, 0x01, 0xf0, 0xfe, 0x07, 0xf0
};
const unsigned char loading[] PROGMEM = {
  0x00, 0x00, 0x00, 0x00, 0x00, 0x00, 0x00, 0x00, 0x00, 0x00, 0x00, 0x00, 0x00, 0x00, 0x00, 0x00,
  0x00, 0x00, 0x00, 0x00, 0x00, 0x00, 0x00, 0x00, 0x00, 0x00, 0x00, 0x00, 0x00, 0x00, 0x00, 0x00,
  0x00, 0x00, 0x00, 0x00, 0x00, 0x00, 0x00, 0x00, 0x00, 0x00, 0x00, 0x00, 0x00, 0x00, 0x00, 0x00,
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  0x00, 0x00, 0x00, 0x00, 0x00, 0x00, 0x00, 0x00, 0x00, 0x00, 0x00, 0x00, 0x00, 0x00, 0x00
};
const unsigned char icon_temperature[] PROGMEM = {
  0x00, 0x70, 0x00, 0x00, 0x00, 0xf8, 0x00, 0x00, 0x00, 0xfc, 0x00, 0x00, 0x01, 0xfc, 0x00, 0x00,
  0x01, 0xfc, 0x00, 0x00, 0x3d, 0xfc, 0x00, 0x00, 0x01, 0xfc, 0x00, 0x00, 0x01, 0xfc, 0x00, 0x00,
  0x0d, 0xfc, 0x00, 0x00, 0x01, 0xfc, 0x7e, 0x70, 0x0d, 0xfc, 0x42, 0x58, 0x01, 0xfc, 0xc3, 0x70,
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  0x01, 0xfc, 0x00, 0x00, 0x00, 0x78, 0x00, 0x00
};
const unsigned char icon_reloj[] PROGMEM = {
  0x00, 0x1f, 0xe0, 0x00, 0x00, 0x7f, 0xf8, 0x00, 0x01, 0xff, 0xfe, 0x00, 0x03, 0xff, 0xff, 0x00,
  0x0f, 0xff, 0xff, 0xc0, 0x0f, 0xfc, 0xff, 0xc0, 0x1f, 0xfc, 0xff, 0xe0, 0x3f, 0xfc, 0xff, 0xf0,
  0x3f, 0xfc, 0xff, 0xf0, 0x7f, 0xfc, 0xff, 0xf8, 0x7f, 0xfc, 0xff, 0xf8, 0xff, 0xfc, 0xff, 0xfc,
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  0x00, 0x7f, 0xfc, 0x00, 0x00, 0x1f, 0xe0, 0x00
};
const unsigned char schedule[] PROGMEM = {
  0x18, 0x01, 0x80, 0x18, 0x01, 0x80, 0x7f, 0xff, 0xe0, 0xd8, 0x01, 0xb0, 0xd8, 0x01, 0xb0, 0xc0,
  0x00, 0x30, 0xff, 0xff, 0xf0, 0xc0, 0x00, 0x30, 0xc0, 0x00, 0x30, 0xd3, 0x6c, 0xb0, 0xd2, 0x64,
  0xb0, 0xc0, 0x00, 0x30, 0xd3, 0x6c, 0xb0, 0xd3, 0x6c, 0xb0, 0xc0, 0x00, 0x30, 0xd2, 0x64, 0x30,
  0xd3, 0x6c, 0x30, 0xc0, 0x00, 0x30, 0xff, 0xff, 0xf0, 0x7f, 0xff, 0xe0
};
const unsigned char satelite[] PROGMEM = {
  0x00, 0x00, 0x00, 0x00, 0x00, 0x00, 0x00, 0x00, 0x60, 0x00, 0x00, 0x00, 0x00, 0xf0, 0x00, 0x00,
  0x00, 0x00, 0xf8, 0x00, 0x00, 0x00, 0x02, 0x7c, 0x00, 0x00, 0x00, 0x07, 0x3e, 0x00, 0x00, 0x00,
  0x03, 0x9c, 0x00, 0x00, 0x00, 0x19, 0xc8, 0x00, 0x00, 0x30, 0x3c, 0xe0, 0x00, 0x00, 0x7e, 0x3e,
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  0x00, 0x0f, 0x80, 0x00, 0x00, 0x00, 0x00, 0x00
};
const unsigned char longitud[] PROGMEM = {
  0x00, 0x7f, 0x00, 0x00, 0x01, 0xeb, 0xc0, 0x00, 0x05, 0x2a, 0x50, 0x00, 0x0a, 0x49, 0x28, 0x00,
  0x12, 0x49, 0x24, 0x00, 0x24, 0x49, 0x12, 0x00, 0x24, 0x88, 0x90, 0x00, 0x48, 0x88, 0x89, 0x00,
  0x48, 0x88, 0x89, 0x00, 0x88, 0x88, 0x88, 0x80, 0x88, 0x88, 0x88, 0x80, 0x88, 0x88, 0x88, 0x80,
  0x88, 0x88, 0x88, 0x80, 0x88, 0x88, 0x88, 0x80, 0x88, 0x88, 0x88, 0x80, 0x88, 0x88, 0x88, 0x80,
  0x48, 0x88, 0x89, 0x00, 0x48, 0x88, 0x89, 0x00, 0x24, 0x88, 0x90, 0x00, 0x24, 0x49, 0x12, 0x00,
  0x12, 0x49, 0x24, 0x00, 0x0a, 0x49, 0x28, 0x00, 0x05, 0x2a, 0x50, 0x00, 0x01, 0xeb, 0xc0, 0x00,
  0x00, 0x7f, 0x00, 0x00
};
const unsigned char latitud[] PROGMEM = {
  0x00, 0x00, 0x00, 0x00, 0x00, 0x00, 0x00, 0x00, 0x00, 0x00, 0x00, 0x00, 0x00, 0x3e, 0x00, 0x00,
  0x00, 0xff, 0x80, 0x00, 0x03, 0xf7, 0xe0, 0x00, 0x07, 0x63, 0x30, 0x00, 0x06, 0x63, 0x10, 0x00,
  0x0c, 0x63, 0x18, 0x00, 0x0f, 0xff, 0xf8, 0x00, 0x1f, 0xc1, 0xfc, 0x00, 0x1c, 0x41, 0x9c, 0x00,
  0x3d, 0xdd, 0xde, 0x00, 0x1c, 0xc1, 0x9c, 0x00, 0x1f, 0xc1, 0xfc, 0x00, 0x0f, 0xff, 0xf8, 0x00,
  0x0c, 0x63, 0x18, 0x00, 0x04, 0x63, 0x10, 0x00, 0x06, 0x63, 0x30, 0x00, 0x03, 0xf7, 0xe0, 0x00,
  0x00, 0xff, 0x80, 0x00, 0x00, 0x3e, 0x00, 0x00, 0x00, 0x00, 0x00, 0x00, 0x00, 0x00, 0x00, 0x00,
  0x00, 0x00, 0x00, 0x00
};
const unsigned char check[] PROGMEM = {
  0x00, 0x00, 0x00, 0x00, 0x00, 0x00, 0x00, 0x00, 0x00, 0x00, 0x00, 0x00, 0x00, 0x00, 0x00, 0x00,
  0x00, 0x00, 0x00, 0x78, 0x00, 0x00, 0x00, 0xfc, 0x00, 0x00, 0x01, 0xfc, 0x00, 0x00, 0x03, 0xfc,
  0x00, 0x00, 0x07, 0xf8, 0x00, 0x00, 0x0f, 0xf0, 0x00, 0x00, 0x1f, 0xe0, 0x00, 0x00, 0x3f, 0xc0,
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  0x00, 0x00, 0x00, 0x00, 0x00, 0x00, 0x00, 0x00
};
const unsigned char icon_sd[] PROGMEM = {
  0x01, 0xff, 0xff, 0xc0, 0x03, 0xfd, 0xdf, 0xe0, 0x03, 0x9d, 0xdc, 0xe0, 0x03, 0x9d, 0xdc, 0xe0,
  0x03, 0x9d, 0xdc, 0xe0, 0x03, 0x9d, 0xdf, 0xe0, 0x03, 0x9d, 0xdf, 0xe0, 0x03, 0xfd, 0xff, 0xe0,
  0x03, 0xff, 0xff, 0xe0, 0x07, 0xff, 0xff, 0xe0, 0x0f, 0xff, 0xff, 0xe0, 0x1f, 0xff, 0xff, 0xe0,
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  0x1f, 0xff, 0xff, 0xe0, 0x0f, 0xff, 0xff, 0xc0
};
const unsigned char ready[] PROGMEM = {
  0x00, 0x1f, 0xe0, 0x00, 0x00, 0x7f, 0xf8, 0x00, 0x01, 0xff, 0xfe, 0x00, 0x03, 0xff, 0xff, 0x00,
  0x0f, 0xff, 0xff, 0xc0, 0x0f, 0xff, 0xff, 0xc0, 0x1f, 0xff, 0xff, 0xe0, 0x3f, 0xff, 0xff, 0xf0,
  0x3f, 0xff, 0xff, 0xf0, 0x7f, 0xff, 0xf9, 0xf8, 0x7f, 0xff, 0xf0, 0xf8, 0xff, 0xff, 0xe0, 0xfc,
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  0x00, 0x7f, 0xfc, 0x00, 0x00, 0x1f, 0xe0, 0x00
};
const unsigned char wifi[] PROGMEM = {
	0x00, 0x00, 0x00, 0x00, 0x00, 0x00, 0x00, 0x00, 0x00, 0x00, 0x00, 0x00, 0x00, 0x00, 0x00, 0x00, 
	0x00, 0x00, 0x00, 0x00, 0x00, 0xff, 0xfc, 0x00, 0x07, 0xff, 0xff, 0x80, 0x1f, 0xff, 0xff, 0xe0, 
	0x3f, 0x80, 0x07, 0xf0, 0xfc, 0x00, 0x00, 0xfc, 0xf0, 0x00, 0x00, 0x3c, 0xe0, 0x7f, 0xf8, 0x1c, 
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	0x00, 0x00, 0x00, 0x00, 0x00, 0x00, 0x00, 0x00
};
const unsigned char icon_dust [] PROGMEM = {
	0x00, 0x00, 0x00, 0x00, 0x00, 0x03, 0x80, 0x00, 0x00, 0x07, 0x80, 0x60, 0x00, 0x0f, 0x80, 0x70, 
	0x00, 0x0f, 0xc0, 0x20, 0x00, 0x0f, 0xc0, 0x00, 0x00, 0x03, 0x80, 0x00, 0x00, 0x00, 0x02, 0x00, 
	0x1a, 0x30, 0x0f, 0x80, 0x14, 0x20, 0x0f, 0x80, 0x28, 0x00, 0xff, 0x80, 0x2c, 0x01, 0x3f, 0x60, 
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	0x00, 0x00, 0x0e, 0x00, 0x00, 0x00, 0x00, 0x00
};
const unsigned char cargaExitosa [160] PROGMEM = {
	0xff, 0xff, 0xff, 0xfc, 0xff, 0xff, 0xff, 0xfc, 0xff, 0xff, 0xff, 0xfc, 0xff, 0xff, 0xff, 0xfc, 
	0xff, 0xff, 0xff, 0xc4, 0xff, 0xff, 0xff, 0x00, 0xff, 0xff, 0xfc, 0x00, 0xff, 0xff, 0xf8, 0x00, 
	0xff, 0xff, 0xf8, 0x0c, 0xff, 0xff, 0xf0, 0x1c, 0xff, 0xff, 0xe0, 0x3c, 0xff, 0xff, 0xc0, 0x7c, 
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	0xff, 0xff, 0xff, 0xfc, 0xff, 0xff, 0xff, 0xfc, 0xff, 0xff, 0xff, 0xfc, 0xff, 0xff, 0xff, 0xfc
};
const unsigned char tranfiriendo [120] PROGMEM = {
	0x00, 0x00, 0x20, 0x00, 0x00, 0x00, 0x70, 0x00, 0x00, 0x00, 0xf0, 0x00, 0x00, 0x01, 0xf0, 0x00, 
	0x07, 0xc3, 0xff, 0x80, 0x1f, 0xc7, 0xff, 0xe0, 0x3f, 0xc7, 0xff, 0xf0, 0x7f, 0x83, 0xff, 0xf8, 
	0x7e, 0x01, 0xf1, 0xf8, 0xfc, 0x00, 0xf0, 0x7c, 0xf8, 0x00, 0x70, 0x7c, 0xf8, 0x00, 0x00, 0x7c, 
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	0x00, 0x38, 0x00, 0x00, 0x00, 0x10, 0x00, 0x00
};
const unsigned char comprobar[] PROGMEM = {
  0x00, 0x01, 0xfc, 0x00, 0x00, 0x06, 0x03, 0x00, 0x00, 0x08, 0x00, 0x80, 0x00, 0x11, 0xfc, 0x20,
  0x00, 0x22, 0x03, 0x10, 0x00, 0x44, 0x00, 0x90, 0x00, 0x88, 0x70, 0x48, 0x00, 0x90, 0x50, 0x48,
  0x00, 0x90, 0x20, 0x24, 0x00, 0x20, 0x30, 0x24, 0x01, 0x20, 0x50, 0x24, 0x01, 0x20, 0x50, 0x24,
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  0x8c, 0x00, 0x00, 0x00, 0x78, 0x00, 0x00, 0x00
};
//------------------------------------------------------------------------------------------------------------------------

/*
 * 3. Variables y constantes
 */
#define WIFI_CONNECTION_TIMEOUT 10000
#define FIREBASE_CONNECTION_TIMEOUT 5000
#define RXD2 16
#define TXD2 17
const int botonPin1 = 33;
const int botonPin2 = 34;
bool button33Pressed = false;
bool button34Pressed = false;
bool validacion = false;
const char* ssid = "Gandalf";
const char* password = "12345678";
int value=0;
bool bleInitialized = false;
int values_PM[]={0,0,0,0,0,0,0,0,0,0,0,0};
char buffer_data[3][40];
bool flag = false;
String data_send = "";
float lat = 0;
float lon = 0;
float speed = 0;
float H_T[] = {0,0};
String buffer_pm ="";
char file_name[150];
char* buffer_dht = (char*)malloc(150);
char* buffer_rtc = (char*)malloc(150);
char buffer_gps[4][50];
char* data_gps=(char*) malloc(50);
char* buffer_final = (char*)malloc(200);
unsigned long previousMillis = 0;
char name_folder[100];
int status = WL_IDLE_STATUS;
//------------------------------------------------------------------------------------------------------------------------

/*
 * 4. Operaciones sobre recursos WiFi - Bluetooth
 */
BluetoothSerial SerialBT;
GadgetBle gadgetBle = GadgetBle(GadgetBle::DataType::T_RH_CO2_ALT);
#if !defined(CONFIG_BT_ENABLED) || !defined(CONFIG_BLUEDROID_ENABLED)
  #error Bluetooth is not enabled! Please run `make menuconfig` to and enable it
  #endif
//------------------------------------------------------------------------------------------------------------------------

/*
 * 5. Conexion a la nube Firebase Firestore 
 */
#define API_KEY "AIzaSyCFWxRqlzQPqiEnLzdTQO-jUhECFmrztV4"
#define FIREBASE_PROJECT_ID "esp32-cbe93"
#define USER_EMAIL "esp32sergio@gmai.com"
#define USER_PASSWORD "Tomate123##"
FirebaseData fbdo;
FirebaseAuth auth;
FirebaseConfig config;
//------------------------------------------------------------------------------------------------------------------------

/*
 * 6. Conexion Red de malla Mesh Ad - Hoc
 */
#define   MESH_PREFIX     "RED_USA_2023"
#define   MESH_PASSWORD   "USA123*."
#define   MESH_PORT       5555
Scheduler userScheduler;
painlessMesh  mesh;
void sendMessage();
Task taskSendMessage( TASK_SECOND * 1 , TASK_FOREVER, &sendMessage );
//------------------------------------------------------------------------------------------------------------------------

/*
 * 7. Conexion a modulos ESP32
 * 7.1. Display OLED
 * 7.2. DHT11
 * 7.3. Neo GPS
 * 7.4. PM 2.5
 * 7.5. Rtc DS3231
 */
#define OLED_ADDRESS 0x3C
Adafruit_SSD1306 display = Adafruit_SSD1306(128, 64, &Wire, OLED_ADDRESS);
//------
#define DHTPIN 27
#define DHTTYPE DHT11
DHT dht(DHTPIN, DHTTYPE);
//------
HardwareSerial neogps(2);
#define NMEA 0
#define I2C_ADDR 0x27
TinyGPSPlus gps;
//------
struct pms5003data {
  uint16_t framelen;
  uint16_t pm10_standard, pm25_standard, pm100_standard;
  uint16_t pm10_env, pm25_env, pm100_env;
  uint16_t particles_03um, particles_05um, particles_10um, particles_25um, particles_50um, particles_100um;
  uint16_t unused;
  uint16_t checksum;
};
struct pms5003data data;
Adafruit_PM25AQI aqi = Adafruit_PM25AQI();
SoftwareSerial pmsSerial(32,25);
//------
RtcDS3231<TwoWire> Rtc(Wire);
RTC_DS3231 rtc;
SPIClass spi(HSPI);
//------------------------------------------------------------------------------------------------------------------------

/*
 * 8. Declaracion de funciones
 */
void data_DHT_11_display(float, float, float, float, float);
void receivedCallback(uint32_t from, String& msg);
void newConnectionCallback(uint32_t nodeId);
void changedConnectionCallback();
void nodeTimeAdjustedCallback(int32_t offset);
void delayReceivedCallback(uint32_t from, int32_t delay);
bool menu_show_data();
bool menu();
void data_RTC_HW_084();
void send_data_PM2();  
void data_GPS_NEO6MV2();
void wait_screen(long interval);  
//------------------------------------------------------------------------------------------------------------------------

/*
 * 9. Funciones
 */
/*
 * 9.1. Funcion usada para el envio de informacion por la red de malla
 */
void sendMessage() {
  char set_data[2000];
  data_DHT_11();
  data_RTC_HW_084();
  send_data_PM2();
  //data_GPS_NEO6MV2();
  String head = "Fecha;Hora;Temperatura_Reloj;Humedad;TemperaturaC;TemperaturaF;CalorF;CalorC;Longuitud;Latitud;Velocidad;Satelites;PM1.0;PM2.5;PM10;PM_ENV1.0;PM_ENV2.5;PM_ENV10.0;PM0.3um;PM0.5um;PM1um;PM2.5um;PM5um;PM10um\n";
  snprintf(set_data + strlen(set_data), sizeof(set_data) - strlen(set_data), "%s%s", buffer_rtc, buffer_dht);
  strcat(set_data,buffer_pm.c_str());
  data_send = String(set_data);
  mesh.sendBroadcast( data_send );
  taskSendMessage.setInterval( random( TASK_SECOND * 1, TASK_SECOND * 5 ));
}

/*
 * 9.2. Funcion usada para recibir informacion por la red de malla
 */
void receivedCallback(uint32_t from, String &msg) {
  Serial.print("Mensaje Recibido: ");
  Serial.println(msg.c_str());
  Serial.println(String(from));
  char name_folder[] = "/ESP_ID";
  char id[20];
  sprintf(id, "%lu", from);
  char from_str[20];
  itoa(from, from_str, 10);
  strcat(name_folder, from_str);
  Serial.println("El nombre del documento es: ");
  Serial.println(name_folder);
  if (SD.exists(name_folder) == false) {
    SD.mkdir(name_folder);
  }
  String file_name = "";
  Serial.println("Se está creando el archivo recibido");
  file_name = "/ESP_ID" + String(from) + "/data_" + String(from) + ".csv";
  Serial.println("El filename es: ");
  Serial.println(file_name);
  File file = SD.open(file_name, FILE_APPEND);
  if (file) {
    file.println(msg.c_str());
    file.close();
    Serial.println("Se creó el archivo");
    display.clearDisplay();
    display.setFont();
    display.setTextColor(WHITE);
    display.setTextSize(1);
    display.drawBitmap(50, 16, tranfiriendo, 30, 30, WHITE);
    String ms = " Transfiriendo datos \n \n \n \n   nodo: " + String(from) + " \n";
    display.setCursor(4, 7);
    display.println(ms);
    display.display();
    wait_screen(3000);
    display.clearDisplay();
    display.setTextSize(1);
    display.setCursor(0, 0);
    display.println("     Guardando datos          recibidos");
    display.drawBitmap(50, 35, icon_sd, 30, 30, WHITE);
    display.print("  Espacio total:");
    display.print(SD.totalBytes() / (1024 * 1024));
    display.print("Mb");
    display.display();
    wait_screen(1000);
  } else {
    Serial.println("Error al abrir el archivo");
  }
  wait_screen(4000);
  Serial.printf("startHere: Received from %u msg=%s\n", from, msg.c_str());
}

/*
 * 9.3. Funcion usada para establecer una nueva conexion por la red de malla
 */
void newConnectionCallback(uint32_t nodeId) {}

/*
 * 9.4. Funcion usada para cuando se produce un cambio de conexion en la red de malla
 */
void changedConnectionCallback() {}

/*
 * 9.5. Funcion usada para ajustar el tiempo de sincronizacion producido en la red de malla
 */
void nodeTimeAdjustedCallback(int32_t offset) {}

/*
 * 9.6. Funcion usada para un tiempo de retardo para la conexion con los demas nodos en la red de malla
 */
void delayReceivedCallback(uint32_t from, int32_t delay) {
  Serial.printf("Delay to node %u is %d us\n", from, delay);
}

/*
 * 9.7. Funcion usada para activar el WiFi y realizar una conexion con el servicio de base de datos Firebase
 */
bool turn_ON_WIFI() {
  Serial.println("WIFI ON");
  WiFi.begin(ssid, password);
  Serial.print("Connecting to Wi-Fi");
  unsigned long startTime = millis();
  while (WiFi.status() != WL_CONNECTED && millis() - startTime < WIFI_CONNECTION_TIMEOUT)
  {
    Serial.print(".");
    delay(300);
  }
  Serial.println();
  if (WiFi.status() == WL_CONNECTED) {
    Serial.print("Connected with IP: ");
    Serial.println(WiFi.localIP());
    delay(500);
    Serial.printf("Firebase Client v%s\n\n", FIREBASE_CLIENT_VERSION);
    config.api_key = API_KEY;
    auth.user.email = USER_EMAIL;
    auth.user.password = USER_PASSWORD;
    config.token_status_callback = tokenStatusCallback;
    Firebase.begin(&config, &auth);
    Firebase.reconnectWiFi(true);
    Serial.println("Conectó a Firebase");
    unsigned long firebaseStartTime = millis();
    while (!Firebase.ready() && millis() - firebaseStartTime < FIREBASE_CONNECTION_TIMEOUT) {
      delay(100);
    }
    if (Firebase.ready()) {
      Serial.println("Firebase listo");
      return true;
    } else {
      Serial.println("Error: No se pudo establecer conexión con Firebase");
      return false;
    }
  } else {
    Serial.println("Failed to connect to Wi-Fi");
    return false;
  }
}

/*
 * 9.8. Funcion usada para desactivar el WiFi
 */
void turn_OFF_WIFI()
{
  Serial.println("WIFI OFF");
  WiFi.mode(WIFI_MODE_NULL);
  delay(2000);
}

/*
 * 9.9. Funcion usada para activar el Bluetooth y realizar un envio de datos a una aplicacion movil llamada SENSIRION
 * la cual mostrara los datos
 */
void turn_ON_BLE()
{
  SerialBT.begin("ESP32test");
  delay(500);
  if (!bleInitialized)
    {
      gadgetBle.begin();
      Serial.println("Encendió");
      Serial.print("Sensirion GadgetBle Lib initialized with deviceId = ");
      Serial.println(gadgetBle.getDeviceIdString());
      bleInitialized = true;
    }
  delay(2000);
}

/*
 * 9.10. Funcion usada para desactivar
 */
void turn_OFF_BLE()
{
  SerialBT.end();
  delay(2000);
}

/*
 * 9.11. Funcion usada para crear los archivos en la memoria SD
 */
void appendFile(fs::FS& fs, const char* path, const char* message, bool type) {
  File file = fs.open(path, FILE_APPEND);
  if (!file && type) {
    display.clearDisplay();
    display.setFont();
    display.setTextSize(1);
    display.setCursor(40, 10);
    display.setTextColor(WHITE);
    display.println("COMPRUEBE \n      SU SD");
    display.drawBitmap(60, 30, comprobar, 30, 30, WHITE);
    display.display();
    wait_screen(3000);
    type = false;
  }
  if (file && type) {
    file.println(message);
    display.clearDisplay();
    display.setFont();
    display.setTextSize(1);
    display.setCursor(0, 0);
    display.println("\t SUBIENDO ARCHIVOS \n A LA SD ");
    display.drawBitmap(50, 35, icon_sd, 30, 30, WHITE);
    display.setCursor(50, 25);
    display.print("Total space: ");
    display.print(SD.totalBytes() / (1024 * 1024));
    display.print("Mb");
    display.display();
    wait_screen(2000);
    display.clearDisplay();
    display.setFont();
    display.setTextSize(1);
    display.print("Registro exitoso");
    display.drawBitmap(40, 20, ready, 30, 30, WHITE);
    display.setCursor(35, 5);
    char size[1][20];
    sprintf(size[0], "Size file: %dKB", file.size() / 1024);
    display.setCursor(10, 55);
    display.println(size[0]);
    display.display();
    wait_screen(2000);
    file.close();
    Serial.println("Registro exitoso");
  }
  flag = type;
}

/*
 * 9.12. Funcion usada para visualizar los datos correspondientes al GPS via monitor serial
 */
void Visualizacion_Serial() {
  Serial.println("DATOS GPS");
  if (gps.location.isValid() == 1) {
    Serial.print("Lat: ");
    Serial.println(gps.location.lat(),6);
    Serial.print("Lng: ");
    Serial.println(gps.location.lng(),6);
    Serial.print("Speed: ");
    Serial.println(gps.speed.kmph());
    Serial.print("SAT:");
    Serial.println(gps.satellites.value());
    Serial.print("ALT:");
    Serial.println(gps.altitude.meters(), 0);
    Serial.print("Date: ");
    Serial.print(gps.date.day()); Serial.print("/");
    Serial.print(gps.date.month()); Serial.print("/");
    Serial.println(gps.date.year());
    Serial.print("Hour: ");
    Serial.print(gps.time.hour()); Serial.print(":");
    Serial.print(gps.time.minute()); Serial.print(":");
    Serial.println(gps.time.second());
    Serial.println("---------------------------");
  }
}

/*
 * 9.13. Funcion usada para mostrar el menu principal en el display OLED
 */
bool menu(){
  display.invertDisplay(false);
  display.setTextColor(SSD1306_WHITE);
  display.startscrollright(0x00, 0x0F);
  display.stopscroll();
  display.setCursor(2, 33);
  display.setTextColor(BLACK);
  display.drawRect(0, 32, 128, 30, WHITE);
  display.fillRect(0, 32, 128, 30, WHITE);
  display.drawCircle(112, 45, 10, WHITE);
  display.setTextSize(1);
  display.println("SEMILLERO MAKERS");
  display.setCursor(2, 45);
  display.println("->Capturar datos");
  display.setCursor(2, 55);
  display.println("->Red en Malla");
  display.drawBitmap(0, 0, UniversidadSergioArboleda, 128, 30, WHITE);
  display.drawBitmap(105, 38, logo, 20, 20, BLACK);
  display.display();
  wait_screen(2000);
  return true;
}

/*
 * 9.14. Funcion usada para leer la informacion referente al modulo de temperatura y humedad dht11
 */
void data_DHT_11() {
  H_T[0]=dht.readHumidity();
  H_T[1]=dht.readTemperature();
  char numString[20];
  Serial.print("Humedad:");
  Serial.println(dtostrf(dht.readHumidity(), 6, 2, numString));
  Serial.print("Temperatura:");
  Serial.println(dht.readTemperature());
  if (isnan(H_T[0]) || isnan(H_T[1])) {
    Serial.println("Error al leer el sensor DHT!");
    display.display();
  }
  sprintf(buffer_dht, "%2.2f;%2.1f;%3.2f;%3.2f;%3.2f;", H_T[0], H_T[1], dht.convertCtoF(H_T[1]), dht.computeHeatIndex(H_T[1], H_T[0], false), dht.computeHeatIndex(dht.convertCtoF(H_T[1]), H_T[0], true));
  Serial.printf("Humedad: %2.2f, \nTemperatura(°C): %2.1f °C, \nTemperatura(°F): %3.2f °F, \nIndice de calor(°C): %3.2f °C,\nIndice de calor(°F): %3.2f °F", H_T[0], H_T[1], dht.convertCtoF(H_T[1]), dht.computeHeatIndex(H_T[1], H_T[0], false), dht.computeHeatIndex(dht.convertCtoF(H_T[1]), H_T[0], true));
  Serial.print("\nBuffer dht: ");
  Serial.println(buffer_dht);
}

/*
 * 9.15. Funcion usada para mostrar la informacion referente al modulo de temperatura y humedad en el display OLED
 */
void data_DHT_11_display(float t_c, float h, float t_f, float idx_c, float idx_f) {
  char buffer_data[5][100];
  float list_data_recolected[] = { t_c, t_f, h, idx_c, idx_f };
  String alias[5][2] = { { "Temp:", "C" }, { "Temp:", "F" }, { "Humedad:", "%" }, { "IndCalor:", "C" }, { "IndCalor:", "F" } };
  for (int j = 0; j < sizeof(alias) / sizeof(alias[0]); j++) {
    char* myString = (char*)malloc(100);
    sprintf(myString, "%s %2.2f %s", alias[j][0], list_data_recolected[j], alias[j][1]);
    strcpy(buffer_data[j], myString);
    free(myString);
  }
  display.setFont(&FreeSerifBoldItalic9pt7b);
  display.invertDisplay(false);
  display.setCursor(15, 10);
  display.println("Temperatura");
  display.drawBitmap(55, 30, icon_temperature, 30, 30, WHITE);
  display.display();
  wait_screen(2000);
  display.clearDisplay();
  display.setFont();
  display.setCursor(0, 0);
  display.print("\t LISTADO DE DATOS \t ");
  display.setCursor(25, 11);
  display.println(buffer_data[0]);
  display.setCursor(25, 20);
  display.println(buffer_data[1]);
  display.drawBitmap(0, 10, temperature, 19, 20, WHITE);
  display.drawRect(0, 10, 128, 20, WHITE);
  display.setCursor(25, 30);
  display.println(buffer_data[2]);
  display.setCursor(25, 40);
  display.println(buffer_data[3]);
  display.drawRect(0, 29, 128, 20, WHITE);
  display.drawBitmap(0, 30, icon_humedity, 20, 20, WHITE);
  display.setCursor(25, 55);
  display.println(buffer_data[4]);
  display.setCursor(25, 65);
  display.drawRect(0, 48, 128, 20, WHITE);
  display.drawBitmap(0, 50, icon_hot, 20, 20, WHITE);
  display.display();
  wait_screen(3000);
}

/*
 * 9.16. Funcion usada para leer la informacion referente al modulo de reloj en tiempo real DS3231
 */
void data_RTC_HW_084() {
  DateTime now = rtc.now();
  sprintf(buffer_rtc, "%02u/%02u/%04u;%02u:%02u:%02u;%.3f;", now.month(), now.day(), now.year(), now.hour(), now.minute(), now.second(), rtc.getTemperature() / 100);
  Serial.print("Buffer RTC: ");
  Serial.println(buffer_rtc);
}

/*
 * 9.17. Funcion usada para mostrar la informacion referente al modulo de reloj en tiempo real DS3231 en el display OLED
 */
void data_RTC_HW_084_display(String fecha, String hora, String t) {
  String alias[3][2] = { { "Fecha:", fecha }, { "Hora:", hora }, { "Temp:", t } };
  for (int j = 0; j < sizeof(alias) / sizeof(alias[0]); j++) {
    char* myString = (char*)malloc(40);
    sprintf(myString, "%s %s", alias[j][0], alias[j][1]);
    strcpy(buffer_data[j], myString);
    free(myString);
  }
  Serial.println(alias[0][1]);
  display.clearDisplay();
  display.setFont(&FreeSerifBoldItalic9pt7b);
  display.setCursor(15, 10);
  display.println("       Reloj");
  display.drawBitmap(55, 30, icon_reloj, 30, 30, WHITE);
  display.display();
  wait_screen(1000);
  display.clearDisplay();
  display.setFont();
  display.setTextSize(1);
  display.setCursor(0, 0);
  display.print("\t LISTADO DE DATOS \t ");
  display.drawBitmap(20, 9, schedule, 19, 20, WHITE);
  display.drawBitmap(60, 9, clockl, 19, 20, WHITE);
  display.drawBitmap(100, 9, temperature, 19, 20, WHITE);
  display.drawRoundRect(19, 8, 22, 23, 2, WHITE);
  display.drawRoundRect(59, 8, 22, 23, 2, WHITE);
  display.drawRoundRect(99, 8, 22, 23, 2, WHITE);
  display.drawLine(0, 32, 128, 32, WHITE);
  display.setCursor(20, 35);
  display.print(buffer_data[0]);
  display.drawLine(0, 43, 128, 43, WHITE);
  display.setCursor(20, 46);
  display.println(buffer_data[1]);
  display.drawLine(0, 54, 128, 54, WHITE);
  display.setCursor(20, 56);
  display.println(buffer_data[2]);
  display.drawLine(0, 65, 128, 69, WHITE);
  display.display();
  wait_screen(3000);
}

/*
 * 9.18. Funcion usada para leer la informacion referente al modulo de GPS
 */
void data_GPS_NEO6MV2() {
  Visualizacion_Serial();
  boolean newData = false;
  for (unsigned long start = millis(); millis() - start < 1000;) {
      unsigned long time_flag=millis();
      while (true) {
        Serial.println("");
        Serial.print("Bytes Entrada:");
        Serial.print(neogps.available());
        Serial.print("  Satelites:");
        Serial.print(gps.satellites.value());
        Serial.print("  Latitud:");
        Serial.print(gps.location.lat());
        Serial.print("  Longuitud:");
        Serial.print(gps.location.lng());
        Serial.print("  Tiempo:");
        Serial.print(millis()-time_flag);
        if (gps.encode(neogps.read())) {
          newData = true;
        }
        if (gps.satellites.value() > 0 || millis()-time_flag>=5000) {
          Serial.print("\nSatelites:");
          Serial.println(gps.satellites.value());
          Serial.print("Bytes Entrante:");
          Serial.println(neogps.available());
          break;
        }
        
      }
    }
    if (newData == true) {
      newData = false;
      Visualizacion_Serial();
      lat = gps.location.lat();
      lon = gps.location.lng();
      speed = gps.speed.kmph();
      String variables[4][1] = { { String(roundf(lat * 100) / 100) }, { String(roundf(lon * 100) / 100) }, { String(roundf(speed * 100) / 100) }, { String(gps.satellites.value()) } };
      for (int k = 0; k < 4; k++) {
        char* myString = (char*)malloc(50);
        sprintf(myString, "%3.2f:", atof(variables[k][0].c_str()));
        strcpy(buffer_gps[k], myString);
        free(myString);
        strcat(buffer_final, buffer_gps[k]);
      }
    } else {
      char values_gps_default[]="0;";
      for(int k=0;k<sizeof(buffer_gps)/sizeof(buffer_gps[0]);k++){
        strcpy(buffer_gps[k],values_gps_default);
        strcat(buffer_final, buffer_gps[k]);
      }
    }
}

/*
 * 9.19. Funcion usada para leer la informacion referente al modulo de particulas PM 2.5
 */
boolean readPMSdata(Stream *s) {
  if (! s->available()) {
    return false;
  }
  if (s->peek() != 0x42) {
    s->read();
    return false;
  }
  if (s->available() < 32) {
    return false;
  } 
  uint8_t buffer[32];    
  uint16_t sum = 0;
  s->readBytes(buffer, 32);
  for (uint8_t i=0; i<30; i++) {
    sum += buffer[i];
  }
  uint16_t buffer_u16[15];
  for (uint8_t i=0; i<15; i++) {
    buffer_u16[i] = buffer[2 + i*2 + 1];
    buffer_u16[i] += (buffer[2 + i*2] << 8);
  }
  memcpy((void *)&data, (void *)buffer_u16, 30);
  if (sum != data.checksum) {
    Serial.println("Checksum failure");
    return false;
  }   
  return true;
}

/*
 * 9.20. Funcion usada para leer la informacion referente al modulo de particulas PM 2.5 mediante el monitor serial
 */
void send_data_PM2(){
  if (buffer_pm.length() > 0){
    buffer_pm="";
  }
  if (!readPMSdata(&pmsSerial)) {
    Serial.println("Could not read from AQI");
    for(int f=0;f<sizeof(values_PM)/sizeof(values_PM[0]);f++){
      buffer_pm+=String(values_PM[f])+";";
    }
    Serial.println("Datos tomados deL PMS5003");
    Serial.println(data.pm10_standard);
    Serial.println(data.pm25_standard);
    Serial.println(data.pm100_standard);
  }else{
    values_PM[0]=data.pm10_standard;
    values_PM[1]=data.pm25_standard;
    values_PM[2]=data.pm100_standard;
    values_PM[3]=data.pm10_env;
    values_PM[4]=data.pm25_env;
    values_PM[5]=data.pm100_env;
    values_PM[6]=data.particles_03um;
    values_PM[7]=data.particles_05um;
    values_PM[8]=data.particles_10um;
    values_PM[9]=data.particles_25um;
    values_PM[10]=data.particles_50um;
    values_PM[11]=data.particles_100um;
    for(int f=0;f<sizeof(values_PM)/sizeof(values_PM[0]);f++){
      char num[15];
      sprintf(num, "%d",values_PM[f]); 
      buffer_pm+=String(values_PM[f])+";";
    }
    Serial.print("Buffer pm: ");
    Serial.println(buffer_pm);
    Serial.println();
    Serial.println("---------------------------------------");
    Serial.println("Concentration Units (standard)");
    Serial.print("PM 1.0: "); Serial.print(data.pm10_standard);
    Serial.print("\t\tPM 2.5: "); Serial.print(data.pm25_standard);
    Serial.print("\t\tPM 10: "); Serial.println(data.pm100_standard);
    Serial.println("---------------------------------------");
    Serial.println("Concentration Units (environmental)");
    Serial.print("PM 1.0: "); Serial.print(data.pm10_env);
    Serial.print("\t\tPM 2.5: "); Serial.print(data.pm25_env);
    Serial.print("\t\tPM 10: "); Serial.println(data.pm100_env);
    Serial.println("---------------------------------------");
    Serial.print("Particles > 0.3um / 0.1L air:"); Serial.println(data.particles_03um);
    Serial.print("Particles > 0.5um / 0.1L air:"); Serial.println(data.particles_05um);
    Serial.print("Particles > 1.0um / 0.1L air:"); Serial.println(data.particles_10um);
    Serial.print("Particles > 2.5um / 0.1L air:"); Serial.println(data.particles_25um);
    Serial.print("Particles > 5.0um / 0.1L air:"); Serial.println(data.particles_50um);
    Serial.print("Particles > 10.0 um / 0.1L air:"); Serial.println(data.particles_100um);
    Serial.println("---------------------------------------");
    Serial.print("MUESTRADO DE LAS DATOS");
    Serial.print(F("PM 1.0: ")); Serial.print(values_PM[0]);
    Serial.print(F("\t\tPM 2.5: ")); Serial.print(values_PM[1]);
    Serial.print(F("\t\tPM 10: ")); Serial.println(values_PM[2]);
    wait_screen(3000);
  }
}

/*
 * 9.21. Funcion usada para mostrar el menu respectivo a captura de informacion
 */
bool menu_show_data() {
  unsigned long currentMillis = millis();
  previousMillis = millis();
  long interval = 3000;
  int k = 5000;
  while (currentMillis - previousMillis < interval) {
    currentMillis = millis();
    display.clearDisplay();
    display.setFont();
    display.setTextColor(WHITE);
    display.setTextSize(1);
    display.drawCircle(67, 32, 8, WHITE);
    display.drawBitmap(50, 15, loading, 35, 35, WHITE);
    String ms = "Se esta recopilando     la informacion \n \n \n \n  Espere un momento. \n Faltan    segundos.....";
    display.setCursor(4, 4);
    display.println(ms);
    display.setCursor(55, 52);
    char str[20];
    sprintf(str, "%d", k / 1000);
    display.print(str);
    display.display();
    k = 5000 - (currentMillis - previousMillis);
  }
  DateTime now = rtc.now();
  char set_data[2000];
  data_DHT_11();
  data_RTC_HW_084();
  send_data_PM2();
  data_GPS_NEO6MV2();
  String head = "Fecha;Hora;Temperatura_Reloj;Humedad;TemperaturaC;TemperaturaF;CalorF;CalorC;Longuitud;Latitud;Velocidad;Satelites;PM1.0;PM2.5;PM10;PM_ENV1.0;PM_ENV2.5;PM_ENV10.0;PM0.3um;PM0.5um;PM1um;PM2.5um;PM5um;PM10um\n";
  Serial.print(set_data);
  Serial.println(buffer_rtc);
  Serial.println(buffer_dht);
  Serial.println(buffer_final);
  Serial.println(buffer_pm);
  const char* id = "/ESP_ACTUAL";
  char folder_name[50];
  strcpy(folder_name, id);
  if (!SD.exists(folder_name)) {
    if(SD.mkdir(folder_name)){
        Serial.println("Carpeta creada exitosamente");
    }
    else{
        Serial.println("Ocurrió un error mientras se creaba la carpeta");
    }
  }
  snprintf(file_name,sizeof(file_name), "%s/data_%d.csv",folder_name, mesh.getNodeId());
  strcpy(set_data, "");
  Serial.print("Ruta al archivo:");
  Serial.println(file_name);
  snprintf(set_data + strlen(set_data), sizeof(set_data) - strlen(set_data), "%s%s", buffer_rtc, buffer_dht);
  for (int k = 0; k < sizeof(buffer_gps) / sizeof(buffer_gps[0]); k++) {
    snprintf(set_data + strlen(set_data), sizeof(set_data) - strlen(set_data), "%s", buffer_gps[k]);
  }
  strcat(set_data,buffer_pm.c_str());
  const char* const_file_name = file_name;
  data_send = String(set_data);
  delay(4000);
  value++;
  display.clearDisplay();
  data_DHT_11_display(H_T[1], H_T[0], dht.convertCtoF(H_T[1]), dht.computeHeatIndex(H_T[1], H_T[0], false), dht.computeHeatIndex(dht.convertCtoF(H_T[1]), H_T[0], true));
  float t = Rtc.GetTemperature().AsCentiDegC() / 100;
  Serial.print("Hora:");
  Serial.println(String(now.month()) + "/" + String(now.day()) + "/" + String(now.year()));
  data_RTC_HW_084_display(String(now.month()) + "/" + String(now.day()) + "/" + String(now.year()), String(now.hour()) + ":" + String(now.minute()) + ":" + String(now.second()), String(t) + " C");
  display.clearDisplay();
  display.drawBitmap(10,10,icon_dust,30,25,WHITE);
  display.setTextColor(WHITE);
  display.setCursor(60,5); 
  display.println("SENSOR DE \n           POLVO PM");
  display.setCursor(60,20);
  display.printf("PM 10: %u\n  PM 25: %u\n  PM 100: %u\n  PM_env10: %u\n PM_env25: %u",values_PM[0],values_PM[1],values_PM[2],values_PM[3],values_PM[4]);
  display.display();
  wait_screen(3000);
  display.clearDisplay();
  display.setTextColor(WHITE);
  display.drawBitmap(20, 3, check, 30, 30, WHITE);
  display.setCursor(80, 22);
  display.setFont();
  char data_aux[10];
  int longitud = strlen(buffer_gps[3]);
  String miString = String(buffer_gps[3]).substring(0, longitud - 1);
  display.setCursor(5, 30);
  display.print("\nSATELITES DETECTADOS \n     EN LA ZONA");
  display.setCursor(80,15);
  display.setTextSize(2);
  display.print(miString);
  display.setTextSize(1);
  display.setCursor(5, 55);
  display.println("  Sincronizando...    ");
  display.display();
  wait_screen(3000);
  display.clearDisplay();
  display.setFont();
  display.drawBitmap(55,0,logo_ste,30,30,WHITE);
  display.setCursor(1,40);
  display.print("Latitud:");
  display.print(get_values(0));
  display.print(" Long:");
  display.println(get_values(1));
  display.print("Velocidad:");
  display.println(get_values(2));
  display.print("Num.satelites:");
  display.print(get_values(3));
  display.drawFastHLine(0,30,180,WHITE);
  display.display();
  wait_screen(3000);
  display.clearDisplay();
  display.clearDisplay();
  display.drawBitmap(5,0,Sensirion,115,50, WHITE);
  display.setFont();
  display.setTextSize(1);
  display.setFont(&FreeSerifBoldItalic9pt7b);
  display.invertDisplay(false);
  display.setCursor(3, 61);
  display.println("Enviando Datos");
  display.display();
  wait_screen(2000);
  delay(1000);
    turn_ON_BLE();
    delay(2000);
    unsigned long lastMmntTime = 0;
    unsigned long startCheckingAfterMs = 5000;
    if (millis() - lastMmntTime >= startCheckingAfterMs)
    {
      gadgetBle.writePM1p0(values_PM[0]);
      gadgetBle.writePM2p5(values_PM[1]);
      gadgetBle.writePM10p0(values_PM[2]);
      gadgetBle.writeTemperature(H_T[1]);
      gadgetBle.writeHumidity(H_T[0]);
      Serial.print("Datos enviados a sensirion: ");
      Serial.print(values_PM[0]);
      Serial.print(values_PM[1]);
      Serial.print(values_PM[2]);
      Serial.print(H_T[1]);
      Serial.print(H_T[0]);
      gadgetBle.commit();
      lastMmntTime = millis();
    }
    gadgetBle.handleEvents();
    delay(10000);
    turn_OFF_BLE();
    delay(500);
    display.clearDisplay();
    display.drawBitmap(50,0,cargaExitosa,30,40, WHITE);
    display.setFont();
    display.setTextSize(1);
    display.setFont(&FreeSerifBoldItalic9pt7b);
    display.invertDisplay(false);
    display.setCursor(12, 61);
    display.println("Envio Exitoso");
    display.display();
    wait_screen(2000);
    delay(500);
    display.clearDisplay();
    display.drawBitmap(5,0,fire,115,50, WHITE);
    display.setFont();
    display.setTextSize(1);
    display.setFont(&FreeSerifBoldItalic9pt7b);
    display.invertDisplay(false);
    display.setCursor(3, 61);
    display.println("Enviando Datos");
    display.display();
    wait_screen(2000);
    if (turn_ON_WIFI()){
      FirebaseJson content;
      float temperature = dht.readTemperature();
      float humidity = dht.readHumidity();
      if (!isnan(temperature) && !isnan(humidity)) {
        FirebaseJson content;
        content.set("fields/Temperature/stringValue", String(temperature, 2));
        content.set("fields/Humidity/stringValue", String(humidity, 2));
        String documentPath = "DHT11/" + String(millis());
        Serial.print("Adding DHT Data... ");
        if (Firebase.Firestore.patchDocument(&fbdo, FIREBASE_PROJECT_ID, "", documentPath.c_str(), content.raw(), "Temperature") && Firebase.Firestore.patchDocument(&fbdo, FIREBASE_PROJECT_ID, "", documentPath.c_str(), content.raw(), "Humidity")) {
          Serial.printf("ok\n%s\n\n", fbdo.payload().c_str());
          } else {
            Serial.println(fbdo.errorReason());
          }
          } else {
            Serial.println("Failed to read DHT data.");
        }
      delay(1000);
    }
    display.clearDisplay();
    display.drawBitmap(50,0,cargaExitosa,30,40, WHITE);
    display.setFont();
    display.setTextSize(1);
    display.setFont(&FreeSerifBoldItalic9pt7b);
    display.invertDisplay(false);
    display.setCursor(12, 61);
    display.println("Envio Exitoso");
    display.display();
    wait_screen(2000);
  delay(500);
  turn_OFF_WIFI();
  appendFile(SD, const_file_name, data_send.c_str(), true);
  return true; 
}

/*
 * 9.22. Funcion usada para la extraccion de informacion para el modulo GPS especificamente para la longitud
 */
String get_values(int k){
  int longitud = strlen(buffer_gps[k]);
  return String(buffer_gps[k]).substring(0, longitud - 1);
}

/*
 * 9.22. Funcion usada para el control de espera en el mostrado de vistas en el display OLED
 */
void wait_screen(long interval) {
  unsigned long currentMillis = millis();
  previousMillis = millis();
  while (currentMillis - previousMillis < interval) {
    currentMillis = millis();
  }
}
//------------------------------------------------------------------------------------------------------------------------

void setup() {
  Serial.begin(115200);
  pmsSerial.begin(9600);
  display.begin(SSD1306_SWITCHCAPVCC, OLED_ADDRESS);
  display.clearDisplay();
  if(!SD.begin(5)){
    Serial.println("Card Mount Failed");
  }
  uint8_t cardType = SD.cardType();
  if(cardType == CARD_NONE){
        Serial.println("No se tiene una tarjeta insertada");
  }
  uint64_t cardSize = SD.cardSize() / (1024 * 1024);
  Serial.printf("SD Tamaño: %lluMB\n", cardSize);
  Serial.print(SD.numSectors());
  Serial.println(ESP.getFreeHeap());
  Wire.begin();
  dht.begin();
  if (! rtc.begin()) {
    Serial.println("Couldn't find RTC");
    Serial.flush();
    while (1) delay(10);
  }
  if (rtc.lostPower()) {
    Serial.println("RTC lost power, let's set the time!");
    rtc.adjust(DateTime(F(__DATE__), F(__TIME__)));
  }
  pinMode(botonPin1, INPUT);
  pinMode(botonPin2, INPUT);
}

void loop() {
  if (digitalRead(botonPin1) == HIGH || button33Pressed) {
    menu_show_data();
    button33Pressed = true;
  }
  if (digitalRead(botonPin2) == HIGH || button34Pressed) {
    if (!validacion) {
      display.clearDisplay();
      display.setFont();
      display.setTextColor(WHITE);
      display.setTextSize(1);
      display.drawCircle(67, 32, 8, WHITE);
      display.drawBitmap(50, 15, loading, 35, 35, WHITE);
      String ms = "     Conectando      a otros dispositivos \n \n \n \n  Espere un momento. \n";
      display.setCursor(4, 4);
      display.println(ms);
      display.display();
      wait_screen(2000);
      mesh.setDebugMsgTypes( ERROR | STARTUP );  // set before init() so that you can see startup messages
      mesh.init( MESH_PREFIX, MESH_PASSWORD, &userScheduler, MESH_PORT );
      mesh.onReceive(&receivedCallback);
      mesh.onNewConnection(&newConnectionCallback);
      mesh.onChangedConnections(&changedConnectionCallback);
      mesh.onNodeTimeAdjusted(&nodeTimeAdjustedCallback);
      userScheduler.addTask( taskSendMessage );
      taskSendMessage.enable();
      validacion = true;
    }
    mesh.update();
    button34Pressed = true;
  } else {
    menu();
  }
}